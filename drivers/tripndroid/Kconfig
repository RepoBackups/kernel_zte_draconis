## drivers/tripndroid/Kconfig
```kconfig
config TRIPNDROID_FRAMEWORK
        bool "TRIPNDROID Framework"
        select ARM_L1_CACHE_SHIFT_6
        default n
        help
          Implement a custom kernel overhaul for mobile Android devices.
          Currently only supporting Tegra 3 cpu's. Will be platform
          independent in the future

config TDF_HOTPLUG
	bool "TRIPNDROID Hotplug Driver"
	help
	  This option enables turning CPUs on/off according to scheduler loads

config TDF_RQ_STATS
        bool "TDF Scheduler RQ Statistics"
        help
          This option enables load statistics from the scheduler to be
          available to drivers like for example cpu hotplug drivers.
          It is platform independent and every generic hotplug driver is
          able to use it.
          usage: sched_get_nr_running_avg();
```
